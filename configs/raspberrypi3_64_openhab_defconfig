## configs/raspberrypi3_64_openhab_defconfig
```kconfig
BR2_aarch64=y
BR2_cortex_a53=y
BR2_ARM_FPU_VFPV4=y

BR2_TOOLCHAIN_BUILDROOT_CXX=y
BR2_TOOLCHAIN_BUILDROOT_GLIBC=y
BR2_TOOLCHAIN_BUILDROOT_WCHAR=y

BR2_SYSTEM_DHCP="eth0"

# Linux headers same as kernel, a 4.19 series
BR2_PACKAGE_HOST_LINUX_HEADERS_CUSTOM_4_19=y

BR2_LINUX_KERNEL=y
BR2_LINUX_KERNEL_CUSTOM_TARBALL=y
BR2_LINUX_KERNEL_CUSTOM_TARBALL_LOCATION="$(call github,raspberrypi,linux,64d0a9870ac14d5eb5253f67d984ae348eec1393)/linux-64d0a9870ac14d5eb5253f67d984ae348eec1393.tar.gz"
BR2_LINUX_KERNEL_DEFCONFIG="bcmrpi3"

# Build the DTB from the kernel sources
BR2_LINUX_KERNEL_DTS_SUPPORT=y
BR2_LINUX_KERNEL_INTREE_DTS_NAME="broadcom/bcm2710-rpi-3-b broadcom/bcm2710-rpi-3-b-plus broadcom/bcm2837-rpi-3-b"

BR2_LINUX_KERNEL_NEEDS_HOST_OPENSSL=y

BR2_PACKAGE_RPI_FIRMWARE=y

# Login & SSH
BR2_TARGET_ENABLE_ROOT_LOGIN=y
BR2_TARGET_ENABLE_ROOT_LOGIN_SSH=y
BR2_TARGET_GENERIC_ROOT_PASSWD="openhab"
BR2_PACKAGE_OPENSSH=y

# Openhab
BR2_PACKAGE_OPENHAB=y
BR2_PACKAGE_OPENJDK=y

# Selecting BR2_PACKAGE_OPENJDK isn't enough because buildroot is
# apparently not able to select/warn about some dependencies,
# therefore select them manually here.
BR2_PACKAGE_ALSA_LIB=y
BR2_PACKAGE_ALSA_LIB_PCM is not set
BR2_PACKAGE_JPEG=y
BR2_PACKAGE_UTIL_LINUX=y
BR2_PACKAGE_UTIL_LINUX_UUIDD=y
BR2_PACKAGE_XORG7=y
BR2_PACKAGE_ZLIB=y

# Additional utilities
BR2_PACKAGE_IPERF3=y
BR2_PACKAGE_NANO=y
BR2_PACKAGE_WGET=y

# Required tools to create the SD image
BR2_PACKAGE_HOST_DOSFSTOOLS=y
BR2_PACKAGE_HOST_GENIMAGE=y
BR2_PACKAGE_HOST_MTOOLS=y

# Filesystem / image
BR2_TARGET_ROOTFS_EXT2=y
BR2_TARGET_ROOTFS_EXT2_4=y
BR2_TARGET_ROOTFS_EXT2_SIZE="512M"
# BR2_TARGET_ROOTFS_TAR is not set
BR2_ROOTFS_POST_BUILD_SCRIPT="board/raspberrypi3-64/post-build.sh"
BR2_ROOTFS_POST_IMAGE_SCRIPT="board/raspberrypi3-64/post-image.sh"
BR2_ROOTFS_POST_SCRIPT_ARGS="--aarch64 --add-miniuart-bt-overlay"
```

## package/argyll-cms/Config.in
```kconfig
config BR2_PACKAGE_ARGYLL_CMS
	bool "Argyll CMS"
	depends on BR2_TOOLCHAIN_HAS_THREADS
	depends on !BR2_STATIC_LIBS # include dlfcn.h
	select BR2_PACKAGE_JPEG
	select BR2_PACKAGE_LIBPNG
	select BR2_PACKAGE_OPENSSL
	select BR2_PACKAGE_TIFF
	select BR2_PACKAGE_ZLIB
	help
	  ArgyllCMS is an ICC compatible color management system.

	  https://www.argyllcms.com/

comment "Argyll CMS needs a toolchain w/ dynamic library, threads"
	depends on BR2_STATIC_LIBS || !BR2_TOOLCHAIN_HAS_THREADS
```

## package/openhab-addons/Config.in
```kconfig
config BR2_PACKAGE_OPENHAB_ADDONS
	bool "openhab-addons"
	select BR2_PACKAGE_OPENHAB
	help
	  Download the add-on archives for offline use and put them 
	  in the addons folder of the extracted distribution:
	  
	  You don't need the add-ons archives if your machine has Internet access, 
	  openHAB will download add-ons you need online as necessary.
	  
	  https://www.openhab.org/
```

## package/openhab/Config.in
```kconfig
config BR2_PACKAGE_OPENHAB
	bool "openhab"
	select BR2_PACKAGE_OPENJDK
	help
	  open Home Automation Bus is an open source home automation 
	  software written in Java. It is deployed on premise and 
	  connects to devices and services from different vendors. 
	  As of 2019, close to 300 bindings are available as OSGi modules.

	  https://www.openhab.org/
```

## package/openssh/Config.in
```kconfig
config BR2_PACKAGE_OPENSSH
	bool "openssh"
	depends on BR2_USE_MMU # fork()
	select BR2_PACKAGE_OPENSSL
	select BR2_PACKAGE_ZLIB
	help
	  A free version of the SSH protocol suite of network
	  connectivity tools. The standard 'ssh', 'sshd', 'scp', and
	  friends.

	  http://www.openssh.com/

config BR2_TARGET_ENABLE_ROOT_LOGIN_SSH
	bool "Enable root login with password over ssh"
	default n
	help
	  Allow root to log in with a password over ssh.
```
